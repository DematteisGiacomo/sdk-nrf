## samples/dfu/nrf9251_smp_single_slot/sysbuild/mcuboot/boards/nrf9251dk_nrf9251_cpuapp.conf
```kconfig
# Copyright (c) 2026 Nordic Semiconductor ASA
# SPDX-License-Identifier: LicenseRef-Nordic-5-Clause

CONFIG_SINGLE_APPLICATION_SLOT=y

CONFIG_MCUBOOT_SERIAL=y
CONFIG_BOOT_SERIAL_UART=y

CONFIG_UART_CONSOLE=y

CONFIG_BOOT_SERIAL_WAIT_FOR_DFU=y
CONFIG_BOOT_SERIAL_WAIT_FOR_DFU_TIMEOUT=5000

CONFIG_BOOT_SERIAL_NO_APPLICATION=y

CONFIG_BOOT_SERIAL_BOOT_MODE=y
CONFIG_RETAINED_MEM=y
CONFIG_RETAINED_MEM_ZEPHYR_RAM=y
CONFIG_RETENTION=y
CONFIG_RETENTION_BOOT_MODE=y

CONFIG_BOOT_SERIAL_ENTRANCE_GPIO=y

CONFIG_MULTITHREADING=y
CONFIG_FLASH=y
CONFIG_PM=n
CONFIG_POWER_DOMAIN=n
CONFIG_SPI_NOR=n
CONFIG_BOOT_WATCHDOG_FEED=n
CONFIG_MAIN_STACK_SIZE=10240

CONFIG_FPROTECT=n

CONFIG_LOG=y
CONFIG_LOG_MODE_MINIMAL=y
CONFIG_LOG_DEFAULT_LEVEL=3
CONFIG_MCUBOOT_LOG_LEVEL_INF=y
CONFIG_CBPRINTF_NANO=y
CONFIG_PICOLIBC=y
CONFIG_COMMON_LIBC_MALLOC_ARENA_SIZE=0
CONFIG_NCS_APPLICATION_BOOT_BANNER_STRING="MCUboot"

CONFIG_PSA_CRYPTO=y
```
